## config/west.yml
```yaml
manifest:
  remotes:
    - name: zmkfirmware
      url-base: https://github.com/zmkfirmware
    - name: ftc
      url-base: https://github.com/ftc
    - name: own
      url-base: https://github.com/Crafty-Codes
  projects:
    - name: zmk
      remote: own
      revision: mouse-ftc
      import: app/west.yml
  self:
    path: config
```
